## IPET_TEST0514/OTA/components/gpio_drv/Kconfig
```kconfig
# components/gpio_drv/Kconfig

menu "GPIO Driver Configuration"

config GPIO_OUTPUT_0
    int "GPIO Output 0"
    default 10

config GPIO_OUTPUT_1
    int "GPIO Output 1"
    default 2

config GPIO_INPUT_0
    int "GPIO Input 0"
    default 0

config GPIO_INPUT_1
    int "GPIO Input 1"
    default 4

endmenu
```

## IPET_TEST0521/components/i2c_bus/Kconfig
```kconfig
# components/i2c_bus/Kconfig

menu "I2C Driver Configuration"

config I2C_BUS_SDA_GPIO
    int "I2C SDA GPIO"
    default 8

config I2C_BUS_SCL_GPIO
    int "I2C SCL GPIO"
    default 9

endmenu
```
